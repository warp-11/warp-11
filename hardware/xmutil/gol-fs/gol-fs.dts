/*
 * Device tree overlay for the warp11 `gol-fs` xmutil app.
 *
 * Two fragments:
 *   1. &fpga_full firmware-name — tells the kernel's FPGA manager which
 *      bitstream to load when the overlay is applied.
 *   2. &amba golfs@b0000000 — declares the GoL AXI slave as
 *      a generic-uio device so userspace can mmap it via /dev/uioN and
 *      block on the GoL burst/snapshot irq (routed in the BD:
 *      GolAxi.irq → xlconcat → pl_ps_irq0[0] → GIC SPI 89 /
 *      0x59, level-high).
 *
 * The reg size is 0x1000 (4 KB) — only small control registers now;
 * the framebuffer lives in PS DDR (written by the in-fabric AXI master
 * via the HP0_FPD slave port, read by the host through udmabuf0's
 * cached mapping — `memmap=` reservations do not work on this image).
 * Vivado BD must allocate the same range
 * (assign_bd_address ... -range 0x00001000); see mandel_bd_bd.tcl.
 *
 * The kernel cmdline already includes `uio_pdrv_genirq.of_id=generic-uio`,
 * so any node with compatible="generic-uio" auto-binds to uio_pdrv_genirq.
 *
 * Once `xmutil loadapp gol-fs` runs and the overlay applies:
 *   - bitstream programs the PL
 *   - /dev/uioN appears with /sys/class/uio/uioN/name = "golfs"
 *     (the kernel uses the DT node label, not <addr>.<label>)
 *   - /sys/class/uio/uioN/maps/map0/{addr,size} = 0xb0000000, 0x1000
 */

/dts-v1/;
/plugin/;

&fpga_full {
    firmware-name = "xilinx/gol-fs/golfs_bd_wrapper.bit.bin";
};

&amba {
    #address-cells = <2>;
    #size-cells = <2>;

    golfs@b0000000 {
        compatible = "generic-uio";
        reg = <0x0 0xb0000000 0x0 0x1000>;
        interrupt-parent = <&gic>;
        interrupts = <0x0 0x59 0x4>;   /* SPI 89, level-high */
        /* The app declares its own PL clock: loading a bitstream does NOT
         * program the PS clock registers (they keep their boot values —
         * measured: a 166.67 MHz build ticking at the boot default 100 MHz),
         * so the overlay pins pl0_ref (zynqmp clock id 71) and the kernel
         * applies it when this node probes. Apps that omit this inherit
         * whatever the previous app left behind. */
        clocks = <&zynqmp_clk 71>;
        assigned-clocks = <&zynqmp_clk 71>;
        assigned-clock-rates = <166666672>;
    };
};
