/*
 * Device tree overlay for the warp11 `audio-tone` xmutil app.
 *
 * Two fragments:
 *   1. &fpga_full firmware-name — the bitstream the FPGA manager programs
 *      when the overlay applies. This alone makes the tone play (the design
 *      is default-on: AudioToneSlave.enable resets to 1).
 *   2. &amba audio_tone@b0000000 — exposes the AudioTone AXI slave as a
 *      generic-uio device so userspace can optionally mmap it and change
 *      the `enable` / `step` (frequency) registers. No interrupts — the
 *      tone path has no irq.
 *
 * Shares the 0xB0000000 HPM1_FPD aperture with the gol/mandel apps; only
 * one app is loaded at a time via xmutil.
 */

/dts-v1/;
/plugin/;

&fpga_full {
    firmware-name = "xilinx/audio-tone/audio_tone_bd_wrapper.bit.bin";
};

&amba {
    #address-cells = <2>;
    #size-cells = <2>;

    audio_tone@b0000000 {
        compatible = "generic-uio";
        reg = <0x0 0xb0000000 0x0 0x1000>;
    };
};
