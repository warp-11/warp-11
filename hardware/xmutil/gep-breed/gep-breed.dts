/*
 * Device tree overlay for the warp11 `gep-breed` xmutil app.
 *
 * Tells the kernel's FPGA manager which bitstream to load when the overlay
 * is applied. We do NOT declare an AXI device node for GepBreed_axi here;
 * the driver pokes the slave directly via /dev/mem at 0xB000_0000.
 *
 * Once `xmutil loadapp gep-breed` runs, the kernel:
 *   1. Resolves &fpga_full to the KV260's FPGA region.
 *   2. Reads firmware-name => /lib/firmware/xilinx/gep-breed/gepbreed_bd_wrapper.bit.bin
 *   3. Hands it to fpga_manager to program the PL.
 */

/dts-v1/;
/plugin/;

&fpga_full {
    firmware-name = "xilinx/gep-breed/gepbreed_bd_wrapper.bit.bin";
};

/*
 * Hardware-coherent DMA region for the breeding pool. The bitstream routes
 * the pool's m_axi through S_AXI_HPC0_FPD with AxCACHE=0xF, so fabric
 * reads/writes snoop the APU caches; dma-coherent tells the kernel the
 * hardware guarantees coherency, which lets u-dma-buf hand out a CACHED
 * CPU mapping (and makes sync_for_cpu/device no-ops). The u-dma-buf module
 * must be loaded for this node to bind (the board loads it at boot).
 */
&{/} {
    udmabuf_gep_breed: udmabuf-gep-breed {
        compatible = "ikwzm,u-dma-buf";
        device-name = "udmabuf-gep-breed";
        size = <0x00400000>; /* 4 MiB: population x2 + pairing queue + fitness ring */
        dma-coherent;
    };
};
